## conf/layer.conf
```bitbake
BBPATH .= ":${LAYERDIR}"

BBFILES += "${LAYERDIR}/recipes-*/*/*.bb \
            ${LAYERDIR}/recipes-*/*/*.bbappend"

BBFILE_COLLECTIONS += "mantle-bsp"
BBFILE_PATTERN_mantle-bsp = "^${LAYERDIR}/"
BBFILE_PRIORITY_mantle-bsp = "20"
LAYERVERSION_mantle-bsp = "4"
LAYERSERIES_COMPAT_mantle-bsp = "scarthgap"

# FIXME
LAYERDEPENDS_mantle-bsp= " "

BBFILES_DYNAMIC += " \
    intel:${LAYERDIR}/dynamic-layers/intel/recipes-*/*/*.bb \
    intel:${LAYERDIR}/dynamic-layers/intel/recipes-*/*/*.bbappend \
"
```

## conf/machine/include/mantle-x86.inc
```bitbake
MACHINE_EXTRA_RDEPENDS:append = " udev-extraconf "

include conf/machine/include/machine-base.inc

GRUB_TIMEOUT = "5"
LABELS_LIVE = "install"

PREFERRED_PROVIDER_virtual/xserver ?= "xserver-xorg"
XSERVER ?= "${XSERVER_X86_BASE} \
            ${XSERVER_X86_EXT} \
            ${XSERVER_X86_I915} \
            ${XSERVER_X86_I965} \
            ${XSERVER_X86_FBDEV} \
            ${XSERVER_X86_VESA} \
            ${XSERVER_X86_MODESETTING} \
           "

SERIAL_CONSOLE = "115200 ttyS0"
SERIAL_CONSOLES = "115200;ttyS0 115200;tty0"

APPEND = " rootwait raid=noautodetect trace_clock=local quiet "

IMAGE_FSTYPES += "wic iso "
```

## conf/machine/include/x86-64-v4.inc
```bitbake
# Settings for the GCC(1) cpu-type "x86-64-v4":
#
# odd little tune
# Skylake (2015) through Rocket Lake (2021)
#
DEFAULTTUNE ?= "x86-64-v4"

# Include the previous tune to pull in PACKAGE_EXTRA_ARCHS
require conf/machine/include/x86/tune-x86-64-v3.inc

# Extra tune features
TUNEVALID[x86-64-v4] = "Enable x86-64-v4 specific processor optimizations"
TUNE_CCARGS .= "${@bb.utils.contains('TUNE_FEATURES', 'x86-64-v4', ' -march=x86-64-v4', '', d)}"

# Extra tune selections
AVAILTUNES += "x86-64-v4"
TUNE_FEATURES:tune-x86-64-v4 = "${TUNE_FEATURES:tune-x86-64} x86-64-v4"
BASE_LIB:tune-x86-64-v4 = "lib64"
TUNE_PKGARCH:tune-x86-64-v4 = "x86-64-v4"
PACKAGE_EXTRA_ARCHS:tune-x86-64-v4 = "${PACKAGE_EXTRA_ARCHS:tune-x86-64-v3} x86-64-v4"
QEMU_EXTRAOPTIONS_x86-64-v4 = " -cpu Skylake-Client,check=false"

AVAILTUNES += "x86-64-v4-x32"
TUNE_FEATURES:tune-x86-64-v4-x32 = "${TUNE_FEATURES:tune-x86-64-x32} x86-64-v4"
BASE_LIB:tune-x86-64-v4-x32 = "libx32"
TUNE_PKGARCH:tune-x86-64-v4-x32 = "x86-64-v4-x32"
PACKAGE_EXTRA_ARCHS:tune-x86-64-v4-x32 = "${PACKAGE_EXTRA_ARCHS:tune-x86-64-v3-x32} x86-64-v4-x32"
QEMU_EXTRAOPTIONS_x86-64-v4-x32 = " -cpu Skylake-Client,check=false"
```

## conf/machine/mantle-core2-32.conf
```bitbake
#@TYPE: Machine
#@NAME: Mantle Core2 32
#@DESCRIPTION: 32 bit core2 based meta-intel's machine

include conf/machine/include/mantle-x86.inc
include conf/machine/intel-core2-32.conf
MACHINEOVERRIDES:append = ":qemux86"
MACHINE_FEATURES:append = " pcbios i915 efi"

## Bootloader
EFI = "1"
EFI_PROVIDER = "grub-efi"

## Kernel
# linux-mantle-rt 
PREFERRED_PROVIDER_virtual/kernel = "linux-mantle"
PREFERRED_VERSION_linux-mantle = "6.12-rc4"
KERNEL_IMAGETYPE = "bzImage"

PACKAGE_FEED_ARCHS="all ${PACKAGE_EXTRA_ARCHS} core2-32-intel-common x86"
```

## conf/machine/mantle-core2-64.conf
```bitbake
#@TYPE: Machine
#@NAME: Mantle Core2 64
#@DESCRIPTION: 64bit core2

DEFAULTTUNE = "core2-64"
require conf/machine/include/x86/tune-core2.inc
require conf/machine/include/genericx86-common.inc
MACHINEOVERRIDES:append = ":qemux86-64"
MACHINE_FEATURES:append = " pcbios i915 efi"

## Bootloader
EFI = "1"
EFI_PROVIDER = "grub-efi"

## Kernel
PREFERRED_PROVIDER_virtual/kernel = "linux-mantle"
PREFERRED_VERSION_linux-mantle = "6.12-rc4"
KERNEL_IMAGETYPE = "bzImage"

## OTA
PACKAGE_FEED_ARCHS="all ${PACKAGE_EXTRA_ARCHS} x86"

## Qemu (not really needed)
QB_SYSTEM_NAME = "qemu-system-x86_64"
```

## conf/machine/mantle-corei7-64.conf
```bitbake
#@TYPE: Machine
#@NAME: Mantle Os Corei7 64
#@DESCRIPTION: a 64 bit inteli7 based meta-intel machine with multilib support

include conf/machine/include/mantle-x86.inc
require conf/machine/intel-corei7-64.conf
MACHINEOVERRIDES:append = ":x86-64:qemux86-64:intel-corei7-64:corei7-64"
MACHINE_FEATURES:append = " efi pcbios i915"

require conf/multilib.conf
MULTILIBS = "multilib:lib32"
DEFAULTTUNE:virtclass-multilib-lib32 = "core2-32"


## Bootloader
EFI = "1"
EFI_PROVIDER = "grub-efi"

## Kernel 
PREFERRED_PROVIDER_virtual/kernel = "linux-mantle"
PREFERRED_VERSION_linux-mantle = "6.12-rc4"
KERNEL_IMAGETYPE = "bzImage"

## Image
WKS_FILES = "x86-grub2-biosplusefi.wks"
IMAGE_FSTYPES += "wic iso tar.gz"

## OTA
PACKAGE_FEED_ARCHS="all corei7-64 corei7_64 corei7-64-intel-common x86"
```

## conf/machine/mantle-i586.conf
```bitbake
#@TYPE: Machine
#@NAME: Mantle i586
#@DESCRIPTION: 32 bit i586 based meta-yocto-bsp

include conf/machine/include/x86/x86-base.inc
require conf/machine/include/x86/qemuboot-x86.inc
require conf/machine/include/mantle-x86.inc
require conf/machine/include/x86/tune-i586.inc
MACHINEOVERRIDES:append = ":qemux86"
MACHINE_FEATURES:append = " pcbios i915 efi"

## Bootloader 
EFI = "1"
EFI_PROVIDER = "grub-efi"

## Kernel
PREFERRED_VERSION_linux-yocto ?= "6.6%"
PREFERRED_PROVIDER_virtual/kernel ?= "linux-yocto"

## Image 
WKS_FILES = "x86-grub2-biosplusefi.wks"
IMAGE_FSTYPES += "wic iso tar.gz"

QB_SYSTEM_NAME = "qemu-system-i386"
# PACKAGE_FEED_ARCHS="all core2-32 core2_32 core2-32-intel-common x86"
```

## conf/machine/mantle-i686.conf
```bitbake
#@TYPE: Machine
#@NAME: Mantle i686
#@DESCRIPTION: 32 bit i686 based meta-yocto-bsp

include conf/machine/include/x86/x86-base.inc
require conf/machine/include/x86/qemuboot-x86.inc
require conf/machine/include/mantle-x86.inc

require conf/machine/include/x86/tune-i686.inc

PREFERRED_VERSION_linux-yocto ?= "6.6%"
PREFERRED_PROVIDER_virtual/kernel ?= "linux-yocto"

# final "core2-32-intel-common:x86:intel-x86-common:core2-32:qemux86"
MACHINEOVERRIDES:append = ":qemux86"
MACHINE_FEATURES:append = " pcbios i915 efi"

EFI = "1"
EFI_PROVIDER = "grub-efi"

QB_SYSTEM_NAME = "qemu-system-i386"
#PACKAGE_FEED_ARCHS="all core2-32 core2_32 core2-32-intel-common x86"
```

## wic/x86-grub2-biosplusefi.wks
```
part /boot --source bootimg-biosplusefi --sourceparams="loader=grub-efi" --active --align 1024 --use-uuid
part / --source rootfs --ondisk sda --fstype=ext4 --label rootfs --align 4 --size=1024 --use-uuid
part swap --ondisk sda --size=128 --label swap1 --fstype=swap
bootloader --ptable gpt --timeout=5 --append="rootfstype=ext4 console=ttyS3,115200"
```
